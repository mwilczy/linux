## Documentation/devicetree/bindings/display/bridge/starfive,jh7110-inno-hdmi-controller.yaml
```yaml
# SPDX-License-Identifier: (GPL-2.0-only OR BSD-2-Clause)
%YAML 1.2
---
$id: http://devicetree.org/schemas/display/bridge/starfive,jh7110-inno-hdmi-controller.yaml#
$schema: http://devicetree.org/meta-schemas/core.yaml#

title: StarFive JH7110 Innosilicon HDMI Controller

maintainers:
  - Michal Wilczynski <m.wilczynski@samsung.com>

description:
  The controller portion of the StarFive JH7110 INNO HDMI IP.

properties:
  compatible:
    const: starfive,jh7110-inno-hdmi-controller

  interrupts:
    maxItems: 1

  clocks:
    items:
      - description: System clock for register access
      - description: Module clock
      - description: Bus clock
      - description: Pixel clock from PHY

  clock-names:
    items:
      - const: sys
      - const: mclk
      - const: bclk
      - const: pclk

  resets:
    maxItems: 1

  reset-names:
    const: hdmi_tx

  phys:
    maxItems: 1

  phy-names:
    const: hdmi-phy

  ports:
    $ref: /schemas/graph.yaml#/properties/ports
    description:
      A graph node with one input port and one output port.

required:
  - compatible
  - interrupts
  - clocks
  - clock-names
  - resets
  - reset-names
  - phys
  - phy-names
  - ports

additionalProperties: false

examples:
  - |
    #include <dt-bindings/clock/starfive,jh7110-crg.h>
    #include <dt-bindings/reset/starfive,jh7110-crg.h>

    soc {
        #address-cells = <1>;
        #size-cells = <1>;

        hdmi_mfd: hdmi@29590000 {
            compatible = "starfive,jh7110-hdmi-mfd";
            reg = <0x29590000 0x4000>;

            hdmi_phy: phy {
                compatible = "starfive,jh7110-inno-hdmi-phy";
                clocks = <&xin24m>;
                clock-names = "refoclk";
                #clock-cells = <0>;
                clock-output-names = "hdmi_pclk";
                #phy-cells = <0>;
            };

            hdmi_controller: controller {
                compatible = "starfive,jh7110-inno-hdmi-controller";
                interrupts = <99>;
                clocks = <&voutcrg JH7110_VOUTCLK_HDMI_TX_SYS>,
                         <&voutcrg JH7110_VOUTCLK_HDMI_TX_MCLK>,
                         <&voutcrg JH7110_VOUTCLK_HDMI_TX_BCLK>,
                         <&hdmi_phy>;
                clock-names = "sys", "mclk", "bclk", "pclk";
                resets = <&voutcrg JH7110_VOUTRST_HDMI_TX_HDMI>;
                reset-names = "hdmi_tx";
                phys = <&hdmi_phy>;
                phy-names = "hdmi-phy";

                ports {
                    #address-cells = <1>;
                    #size-cells = <0>;

                    port@0 {
                        reg = <0>;
                        hdmi_in: endpoint {
                            remote-endpoint = <&dpu_out_dpi0>;
                        };
                    };

                    port@1 {
                        reg = <1>;
                        hdmi_out: endpoint {
                            remote-endpoint = <&hdmi_con_in>;
                        };
                    };
                };
            };
        };
    };

...
```

## Documentation/devicetree/bindings/display/inno-hdmi.yaml
```yaml
# SPDX-License-Identifier: GPL-2.0-only
%YAML 1.2
---
$id: http://devicetree.org/schemas/display/inno/inno-hdmi.yaml#
$schema: http://devicetree.org/meta-schemas/core.yaml#

title: Innosilicon HDMI Transmitter

maintainers:
  - Sandy Huang <hjc@rock-chips.com>
  - Heiko Stuebner <heiko@sntech.de>
  - Michal Wilczynski <m.wilczynski@samsung.com>

properties:
  compatible:
    oneOf:
      - enum:
          - rockchip,rk3036-inno-hdmi
          - rockchip,rk3128-inno-hdmi
      - const: starfive,jh7110-inno-hdmi

  clocks:
    minItems: 1
    maxItems: 4

  clock-names:
    minItems: 1
    maxItems: 4

  reg:
    maxItems: 1

  interrupts:
    maxItems: 1

  ports:
    $ref: /schemas/graph.yaml#/properties/ports
    properties:
      port@0:
        $ref: /schemas/graph.yaml#/properties/port
        description:
          Port node with one endpoint connected to a video source (e.g., VOP/DC).

      port@1:
        $ref: /schemas/graph.yaml#/properties/port
        description:
          Port node with one endpoint connected to an HDMI connector.
    required:
      - port@0
      - port@1

  "#sound-dai-cells":
    const: 0

required:
  - compatible
  - reg
  - interrupts
  - clocks
  - clock-names
  - ports

allOf:
  - $ref: /schemas/sound/dai-common.yaml#

  # StarFive JH7110 Integration
  - if:
      properties:
        compatible:
          contains:
            const: starfive,jh7110-inno-hdmi
    then:
      properties:
        clocks:
          items:
            - description: System clock
            - description: Master clock for audio
            - description: Bit clock for audio
            - description: Pixel clock from VOUT
        clock-names:
          items:
            - const: sysclk
            - const: mclk
            - const: bclk
            - const: pclk
        resets:
          maxItems: 1
        reset-names:
          const: hdmi_tx
      required:
        - resets
        - reset-names

  # Rockchip Integrations
  - if:
      properties:
        compatible:
          contains:
            enum:
              - rockchip,rk3036-inno-hdmi
              - rockchip,rk3128-inno-hdmi
    then:
      properties:
        clocks:
          items:
            - description: The HDMI controller main clock (pclk)
            - description: The HDMI PHY reference clock (ref)
        clock-names:
          items:
            - const: pclk
            - const: ref
        rockchip,grf:
          $ref: /schemas/types.yaml#/definitions/phandle
          description:
            Phandle to GRF for controlling hsync/vsync polarity.
        power-domains:
          maxItems: 1

# Further nested requirements for different Rockchip SoCs
allOf:
  - if:
      properties:
        compatible:
          contains:
            const: rockchip,rk3036-inno-hdmi
    then:
      required:
        - rockchip,grf

  - if:
      properties:
        compatible:
          contains:
            const: rockchip,rk3128-inno-hdmi
    then:
      required:
        - power-domains

additionalProperties: false

examples:
  - |
    // Example for StarFive JH7110
    #include <dt-bindings/clock/starfive,jh7110-crg.h>
    #include <dt-bindings/interrupt-controller/irq.h>
    #include <dt-bindings/reset/starfive,jh7110-crg.h>

    hdmi: hdmi@29590000 {
        compatible = "starfive,jh7110-inno-hdmi";
        reg = <0x0 0x29590000 0x0 0x4000>;
        interrupts = <99>;
        clocks = <&vout_crg JH7110_VOUTCLK_HDMI_TX_SYS>,
                 <&vout_crg JH7110_VOUTCLK_HDMI_TX_MCLK>,
                 <&vout_crg JH7110_VOUTCLK_HDMI_TX_BCLK>,
                 <&hdmitx0_pixelclk>;
        clock-names = "sysclk", "mclk", "bclk", "pclk";
        resets = <&vout_crg JH7110_VOUTRST_HDMI_TX_HDMI>;
        reset-names = "hdmi_tx";

        ports {
            #address-cells = <1>;
            #size-cells = <0>;

            hdmi_in: port@0 {
                reg = <0>;
                hdmi_enc: endpoint {
                    remote-endpoint = <&dc_out_dpi0>;
                };
            };

            hdmi_out: port@1 {
                reg = <1>;
                hdmi_out_con: endpoint {
                    remote-endpoint = <&hdmi_con_in>;
                };
            };
        };
    };

  - |
    // Example for Rockchip RK3036
    #include <dt-bindings/clock/rk3036-cru.h>
    #include <dt-bindings/interrupt-controller/arm-gic.h>

    hdmi: hdmi@20034000 {
        compatible = "rockchip,rk3036-inno-hdmi";
        reg = <0x20034000 0x4000>;
        interrupts = <GIC_SPI 45 IRQ_TYPE_LEVEL_HIGH>;
        clocks = <&cru PCLK_HDMI>, <&cru SCLK_LCDC>;
        clock-names = "pclk", "ref";
        pinctrl-names = "default";
        pinctrl-0 = <&hdmi_ctl>;
        rockchip,grf = <&grf>;
        #sound-dai-cells = <0>;

        ports {
            #address-cells = <1>;
            #size-cells = <0>;

            port@0 {
                reg = <0>;
                hdmi_in_vop: endpoint {
                    remote-endpoint = <&vop_out_hdmi>;
                };
            };

            port@1 {
                reg = <1>;
            };
        };
    };
```

## Documentation/devicetree/bindings/display/inno/inno-hdmi-common.yaml
```yaml
# SPDX-License-Identifier: GPL-2.0-only OR BSD-2-Clause
%YAML 1.2
---
$id: http://devicetree.org/schemas/display/inno/inno-hdmi-common.yaml#
$schema: http://devicetree.org/meta-schemas/core.yaml#

title: Common properties for the Innosilicon HDMI Transmitter

maintainers:
  - Michal Wilczynski <m.wilczynski@samsung.com>

properties:
  reg:
    maxItems: 1

  interrupts:
    maxItems: 1

  pinctrl-names:
    minItems: 1
    items:
      - const: default

  pinctrl-0:
    description: Pin control configuration.

  ports:
    $ref: /schemas/graph.yaml#/properties/ports

    properties:
      port@0:
        $ref: /schemas/graph.yaml#/properties/port
        description:
          Port node with one endpoint connected to a vop node.

      port@1:
        $ref: /schemas/graph.yaml#/properties/port
        description:
          Port node with one endpoint connected to a hdmi-connector node.

    required:
      - port@0
      - port@1

  "#sound-dai-cells":
    const: 0

required:
  - reg
  - interrupts
  - clocks
  - clock-names
  - ports
  - pinctrl-0
  - pinctrl-names

allOf:
  - $ref: /schemas/sound/dai-common.yaml#

additionalProperties: true
```

## Documentation/devicetree/bindings/display/starfive/starfive,jh7110-inno-hdmi.yaml
```yaml
# SPDX-License-Identifier: GPL-2.0-only OR BSD-2-Clause
%YAML 1.2
---
$id: http://devicetree.org/schemas/display/starfive,jh7110-inno-hdmi.yaml#
$schema: http://devicetree.org/meta-schemas/core.yaml#

title: StarFive JH7110 Innosilicon HDMI Transmitter

maintainers:
  - Michal Wilczynski <m.wilczynski@samsung.com>

allOf:
  - $ref: ../inno/inno-hdmi-common.yaml

properties:
  compatible:
    const: starfive,jh7110-inno-hdmi

  clocks:
    items:
      - description: System clock for the HDMI TX
      - description: Master clock for audio
      - description: Bit clock for audio
      - description: Pixel clock from VOUT

  clock-names:
    items:
      - const: sysclk
      - const: mclk
      - const: bclk
      - const: pclk

  resets:
    maxItems: 1

  reset-names:
    const: hdmi_tx

required:
  - compatible
  - clocks
  - clock-names
  - resets
  - reset-names

additionalProperties: false

examples:
  - |
    #include <dt-bindings/clock/starfive,jh7110-crg.h>
    #include <dt-bindings/reset/starfive,jh7110-crg.h>

    hdmi: hdmi@29590000 {
        compatible = "starfive,jh7110-inno-hdmi";
        reg = <0x0 0x29590000 0x0 0x4000>;
        interrupts = <99>;
        clocks = <&voutcrg JH7110_VOUTCLK_HDMI_TX_SYS>,
                 <&voutcrg JH7110_VOUTCLK_HDMI_TX_MCLK>,
                 <&voutcrg JH7110_VOUTCLK_HDMI_TX_BCLK>,
                 <&hdmitx0_pixelclk>;
        clock-names = "sysclk", "mclk", "bclk", "pclk";
        resets = <&voutcrg JH7110_VOUTRST_HDMI_TX_HDMI>;
        reset-names = "hdmi_tx";
        #sound-dai-cells = <0>;

        ports {
            #address-cells = <1>;
            #size-cells = <0>;

            port@0 {
                reg = <0>;
                endpoint {
                    remote-endpoint = <&dc_out_dpi0>;
                };
            };

            port@1 {
                reg = <1>;
                endpoint {
                    remote-endpoint = <&hdmi_con_in>;
                };
            };
        };
    };
```
