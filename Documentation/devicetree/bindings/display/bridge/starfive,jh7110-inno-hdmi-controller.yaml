## drivers/soc/starfive/Kconfig
```kconfig
# SPDX-License-Identifier: GPL-2.0-only
#
# Starfive SoC drivers
#

if ARCH_STARFIVE || COMPILE_TEST
menu "Starfive SoC drivers"

config SOC_STARFIVE_JH7110_VOUT_SUBSYSTEM
	tristate "StarFive JH7110 VOUT Subsystem Manager"
	help
	  Enable this option to support the VOUT (Video Output) subsystem on
	  the StarFive JH7110 SoC.

	  This driver acts as a parent wrapper for all display related
	  hardware blocks (DC8200, VOUTCRG, HDMI MFD). Its primary
	  responsibility is to manage the shared PD_VOUT power domain,
	  enabling power, clocks, and resets for the entire subsystem
	  before the individual child drivers are probed.

	  This is essential for the display hardware to be detected and
	  to function correctly.

config SOC_STARFIVE_JH7110_HDMI_MFD
    tristate "StarFive JH7110 HDMI MFD Driver"
    depends on OF
    help
	  This option enables the MFD (Multi-Function Device) parent driver
	  for the monolithic StarFive JH7110 HDMI peripheral.

	  The JH7110 HDMI IP block contains both the digital controller
	  (DRM bridge) and the analog PHY (clock/phy provider) logic within
	  a single shared register space.

	  This MFD driver acts as a wrapper. Its only job is to map the
	  shared registers and create separate logical child devices
	  for the "PHY" and the "controller". This is required to
	  correctly manage resources and break a circular clock dependency
	  between the PHY and the VOUT clock generator at probe time.

endmenu
endif
```
