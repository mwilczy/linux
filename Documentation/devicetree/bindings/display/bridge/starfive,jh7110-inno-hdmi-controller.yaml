## Documentation/devicetree/bindings/display/verisilicon,dc8200.yaml
```yaml
# SPDX-License-Identifier: (GPL-2.0-only OR BSD-2-Clause)
%YAML 1.2
---
$id: http://devicetree.org/schemas/display/verisilicon,dc8200.yaml#
$schema: http://devicetree.org/meta-schemas/core.yaml#

title: Verisilicon Vivante DC8200 Display Controller

description:
  Verisilicon Vivante DC8200 IP is used to transfer the image data from a
  video memory buffer to an external LCD interface.

  pipe0 binds HDMI for primary display,
  pipe1 binds DSI for external display.

          +------------------------------+
          |                              |
          |                              |
  +----+  |   +-------------------+      |   +-------+   +------+   +------+
  |    +----->+  dc controller 0  +--->----->+HDMICtl| ->+ PHY  +-->+PANEL0+
  |AXI |  |   +-------------------+      |   +-------+   +------+   +------+
  |    |  |                              |
  |    |  |                              |
  |    |  |                              |
  |    |  |                              |
  |APB |  |   +-------------------+         +---------+    +------+  +-------+
  |    +----->+  dc controller 1  +--->---->+ dsiTx   +--->+DPHY  +->+ PANEL1+
  |    |  |   +-------------------+         +---------+    +------+  +-------+
  +----+  |                              |
          +------------------------------+

maintainers:
  - Michal Wilczynski <m.wilczynski@samsung.com>

properties:
  compatible:
    - const: starfive,jh7110-dc8200
    - const: verisilicon,dc8200

  reg:
    maxItems: 3

  reg-names:
    maxItems: 3

  clocks:
    minItems: 1

  clock-names:
    minItems: 1

  resets:
    minItems: 1

  reset-names:
    minItems: 1

  interrupts:
    maxItems: 1

  ports:
    $ref: /schemas/graph.yaml#/properties/ports

    properties:
      port@0:
        $ref: /schemas/graph.yaml#/properties/port
        description:
          channel 0 output

      port@1:
        $ref: /schemas/graph.yaml#/properties/port
        description:
          channel 1 output

    required:
      - port@0
      - port@1

required:
  - compatible
  - reg
  - interrupts
  - clocks
  - clock-names
  - ports

additionalProperties: false

allOf:
  # Constraints for StarFive JH7110
  - if:
      properties:
        compatible:
          contains:
            const: starfive,jh7110-dc8200
    then:
      properties:
        clocks:
          items::
            - description: Clock for display system noc bus.
            - description: Core clock for display controller.
            - description: Clock for axi bus to access ddr.
            - description: Clock for ahb bus to R/W the phy regs.
            - description: Pixel clock for display channel 0.
            - description: Pixel clock for display channel 1.
            - description: Pixel clock from hdmi.
            - description: Pixel clock for soc.
        clock-names:
          items:
            - const: noc_bus
            - const: dc_core
            - const: axi_core
            - const: ahb
            - const: channel0
            - const: channel1
            - const: hdmi_tx
            - const: dc_parent
        resets:
          items:
            - description: Reset for axi bus.
            - description: Reset for ahb bus.
            - description: Core reset of display controller.
        reset-names:
          items:
            - const: axi
            - const: ahb
            - const: core
      required:
        - resets
        - reset-names

examples:
  - |
    #include <dt-bindings/clock/starfive,jh7110-crg.h>
    #include <dt-bindings/reset/starfive,jh7110-crg.h>
    dc8200: lcd-controller@29400000 {
        compatible = "starfive,jh7110-dc8200";
        reg = <0x29400000 0x100>,
              <0x29400800 0x2000>;
        reg-names = "host", "base";
        interrupts = <95>;
        clocks = <&syscrg JH7110_SYSCLK_NOC_BUS_DISP_AXI>,
                 <&voutcrg JH7110_VOUTCLK_DC8200_CORE>,
                 <&voutcrg JH7110_VOUTCLK_DC8200_AXI>,
                 <&voutcrg JH7110_VOUTCLK_DC8200_AHB>,
                 <&voutcrg JH7110_VOUTCLK_DC8200_PIX0>,
                 <&voutcrg JH7110_VOUTCLK_DC8200_PIX1>,
                 <&hdmitx0_pixelclk>,
                 <&voutcrg JH7110_VOUTCLK_DC8200_PIX>;
        clock-names = "noc_bus", "dc_core", "axi_core", "ahb",
                      "channel0", "channel1", "hdmi_tx", "dc_parent";
        resets = <&voutcrg JH7110_VOUTRST_DC8200_AXI>,
                 <&voutcrg JH7110_VOUTRST_DC8200_AHB>,
                 <&voutcrg JH7110_VOUTRST_DC8200_CORE>;
        reset-names = "axi", "ahb", "core";
        ports {
            #address-cells = <1>;
            #size-cells = <0>;
            dc_out0: port@0 {
                reg = <0>;
                #address-cells = <1>;
                #size-cells = <0>;
                dc_out_dpi0: endpoint@0 {
                    reg = <0>;
                    remote-endpoint = <&hdmi_enc>;
                };
            };
            dc_out1: port@1 {
                reg = <1>;
                #address-cells = <1>;
                #size-cells = <0>;
                dc_out_dpi1: endpoint@1 {
                    reg = <1>;
                    remote-endpoint = <&dsi_enc>;
                };
            };
        };
    };
```

## Documentation/devicetree/bindings/mfd/starfive,jh7110-hdmi-mfd.yaml
```yaml
# SPDX-License-Identifier: (GPL-2.0-only OR BSD-2-Clause)
%YAML 1.2
---
$id: http://devicetree.org/schemas/mfd/starfive,jh7110-hdmi-mfd.yaml#
$schema: http://devicetree.org/meta-schemas/core.yaml#

title: StarFive JH7110 HDMI MFD (Controller+PHY)

maintainers:
  - Michal Wilczynski <m.wilczynski@samsung.com>

description:
  The StarFive JH7110 HDMI block is a monolithic IP containing both
  the digital controller logic and the analog PHY logic in a single
  register space. This MFD wrapper binds to the parent node, creates
  a shared regmap, and populates the PHY and Controller as separate
  child devices to resolve driver dependencies.

properties:
  compatible:
    items:
      - const: starfive,jh7110-hdmi-mfd

  reg:
    maxItems: 1

patternProperties:
  "^phy$":
    $ref: ../phy/starfive,jh7110-inno-hdmi-phy.yaml#
  "^controller$":
    $ref: ../display/bridge/starfive,jh7110-inno-hdmi-controller.yaml#

required:
  - compatible
  - reg

additionalProperties: false

examples:
  - |
    #include <dt-bindings/clock/starfive,jh7110-crg.h>
    #include <dt-bindings/reset/starfive,jh7110-crg.h>

    hdmi_mfd: hdmi@29590000 {
        compatible = "starfive,jh7110-hdmi-mfd", "simple-mfd";
        reg = <0x0 0x29590000 0x0 0x4000>;
        interrupts = <99>;

        hdmi_phy: phy {
            compatible = "starfive,jh7110-inno-hdmi-phy";
            clocks = <&xin24m>;
            clock-names = "refoclk";
            #clock-cells = <0>;
            clock-output-names = "hdmi_pclk";
            #phy-cells = <0>;
        };

        hdmi_controller: controller {
            compatible = "starfive,jh7110-inno-hdmi-controller";
            interrupts = <99>;
            clocks = <&voutcrg JH7110_VOUTCLK_HDMI_TX_SYS>,
                     <&voutcrg JH7110_VOUTCLK_HDMI_TX_MCLK>,
                     <&voutcrg JH7110_VOUTCLK_HDMI_TX_BCLK>,
                     <&hdmi_phy>;
            clock-names = "sys", "mclk", "bclk", "pclk";
            resets = <&voutcrg JH7110_VOUTRST_HDMI_TX_HDMI>;
            reset-names = "hdmi_tx";
            phys = <&hdmi_phy>;
            phy-names = "hdmi-phy";
        };
    };
...
```

## Documentation/devicetree/bindings/phy/starfive,jh7110-inno-hdmi-phy.yaml
```yaml
# SPDX-License-Identifier: (GPL-2.0-only OR BSD-2-Clause)
%YAML 1.2
---
$id: http://devicetree.org/schemas/phy/starfive,jh7110-inno-hdmi-phy.yaml#
$schema: http://devicetree.org/meta-schemas/core.yaml#

title: StarFive JH7110 Innosilicon INNO HDMI PHY

maintainers:
  - Michal Wilczynski <m.wilczynski@samsung.com>

description:
  The PHY portion of the StarFive JH7110 INNO HDMI IP.

properties:
  compatible:
    const: starfive,jh7110-inno-hdmi-phy

  clocks:
    maxItems: 1

  clock-names:
    const: refoclk

  '#clock-cells':
    const: 0

  clock-output-names:
    const: hdmi_pclk

  '#phy-cells':
    const: 0

required:
  - compatible
  - clocks
  - clock-names
  - '#clock-cells'
  - clock-output-names
  - '#phy-cells'

additionalProperties: false

examples:
  - |
    soc {
        #address-cells = <1>;
        #size-cells = <1>;

        hdmi_mfd: hdmi@29590000 {
            compatible = "starfive,jh7110-hdmi-mfd";
            reg = <0x29590000 0x4000>;

            hdmi_phy: phy {
                compatible = "starfive,jh7110-inno-hdmi-phy";
                clocks = <&xin24m>;
                clock-names = "refoclk";
                #clock-cells = <0>;
                clock-output-names = "hdmi_pclk";
                #phy-cells = <0>;
            };
        };
    };

...
```

## Documentation/devicetree/bindings/soc/starfive/starfive,jh7110-vout-subsystem.yaml
```yaml
# SPDX-License-Identifier: (GPL-2.0-only OR BSD-2-Clause)
%YAML 1.2
---
$id: http://devicetree.org/schemas/soc/starfive/starfive,jh7110-vout-subsystem.yaml#
$schema: http://devicetree.org/meta-schemas/core.yaml#

title: StarFive JH7110 VOUT (Video Output) Subsystem

maintainers:
  - Michal Wilczynski <m.wilczynski@samsung.com>

description:
  The JH7110 video output subsystem is an IP block that contains
  the display controller (DC8200), HDMI controller/PHY, and VOUT
  clock generator (VOUTCRG).

properties:
  compatible:
    const: starfive,jh7110-vout-subsystem

  reg:
    maxItems: 1

  power-domains:
    maxItems: 1

  clocks:
    maxItems: 1

  resets:
    maxItems: 1

  ranges: true

  '#address-cells':
    const: 2

  '#size-cells':
    const: 2

patternProperties:
  "^display@[0-9a-f]+$":
    type: object
    description: Verisilicon DC8200 Display Controller node.

  "^hdmi@[0-9a-f]+$":
    type: object
    description: StarFive HDMI MFD (PHY + Controller) node.

  "^clock-controller@[0-9a-f]+$":
    type: object
    description: StarFive VOUT Clock Generator (VOUTCRG) node.

  "^syscon@[0-9a-f]+$":
    type: object
    description: StarFive VOUT Syscon node.

required:
  - compatible
  - reg
  - power-domains
  - clocks
  - resets
  - ranges
  - '#address-cells'
  - '#size-cells'

additionalProperties: false

examples:
  - |
    #include <dt-bindings/clock/starfive,jh7110-crg.h>
    #include <dt-bindings/power/starfive,jh7110-pmu.h>
    #include <dt-bindings/reset/starfive,jh7110-crg.h>

    soc {
        #address-cells = <2>;
        #size-cells = <2>;

        vout_subsystem: display-subsystem@29400000 {
            compatible = "starfive,jh7110-vout-subsystem";
            reg = <0x0 0x29400000 0x0 0x200000>;
            #address-cells = <2>;
            #size-cells = <2>;
            ranges;

            power-domains = <&pwrc JH7110_PD_VOUT>;
            clocks = <&syscrg JH7110_SYSCLK_NOC_BUS_DISP_AXI>;
            resets = <&syscrg JH7110_SYSRST_NOC_BUS_DISP_AXI>;

            dc8200: display@29400000 {
                compatible = "verisilicon,dc";
                reg = <0x0 0x29400000 0x0 0x2800>;
                interrupts = <95>;
                clocks = <&voutcrg JH7110_VOUTCLK_DC8200_CORE>,
                         <&voutcrg JH7110_VOUTCLK_DC8200_AXI>,
                         <&voutcrg JH7110_VOUTCLK_DC8200_AHB>,
                         <&voutcrg JH7110_VOUTCLK_DC8200_PIX0>,
                         <&voutcrg JH7110_VOUTCLK_DC8200_PIX1>;
                clock-names = "core", "axi", "ahb", "pix0", "pix1";
                resets = <&voutcrg JH7110_VOUTRST_DC8200_AXI>,
                         <&voutcrg JH7110_VOUTRST_DC8200_AHB>,
                         <&voutcrg JH7110_VOUTRST_DC8200_CORE>;
                reset-names = "axi", "ahb", "core";
            };

            hdmi_mfd: hdmi@29590000 {
                compatible = "starfive,jh7110-hdmi-mfd";
                reg = <0x0 0x29590000 0x0 0x4000>;
                interrupts = <99>;

                hdmi_phy: phy {
                    compatible = "starfive,jh7110-inno-hdmi-phy";
                    clocks = <&xin24m>;
                    clock-names = "refoclk";
                    #clock-cells = <0>;
                    clock-output-names = "hdmi_pclk";
                    #phy-cells = <0>;
                };

                hdmi_controller: controller {
                    compatible = "starfive,jh7110-inno-hdmi-controller";
                    interrupts = <99>;
                    clocks = <&voutcrg JH7110_VOUTCLK_HDMI_TX_SYS>,
                             <&voutcrg JH7110_VOUTCLK_HDMI_TX_MCLK>,
                             <&voutcrg JH7110_VOUTCLK_HDMI_TX_BCLK>,
                             <&hdmi_phy>;
                    clock-names = "sys", "mclk", "bclk", "pclk";
                    resets = <&voutcrg JH7110_VOUTRST_HDMI_TX_HDMI>;
                    reset-names = "hdmi_tx";
                    phys = <&hdmi_phy>;
                    phy-names = "hdmi-phy";
                };
            };

            voutcrg: clock-controller@295c0000 {
                compatible = "starfive,jh7110-voutcrg";
                reg = <0x0 0x295c0000 0x0 0x10000>;
                clocks = <&syscrg JH7110_SYSCLK_VOUT_SRC>,
                         <&syscrg JH7110_SYSCLK_VOUT_TOP_AHB>,
                         <&syscrg JH7110_SYSCLK_VOUT_TOP_AXI>,
                         <&syscrg JH7110_SYSCLK_VOUT_TOP_HDMITX0_MCLK>,
                         <&syscrg JH7110_SYSCLK_I2STX0_BCLK>,
                         <&hdmi_phy>;
                clock-names = "vout_src", "vout_top_ahb",
                              "vout_top_axi", "vout_top_hdmitx0_mclk",
                              "i2stx0_bclk", "hdmitx0_pixelclk";
                resets = <&syscrg JH7110_SYSRST_VOUT_TOP_SRC>;
                reset-names = "vout_top";
                #clock-cells = <1>;
                #reset-cells = <1>;
            };
        };
    };

...
```

## drivers/gpu/drm/verisilicon/Kconfig
```kconfig
# SPDX-License-Identifier: GPL-2.0

config DRM_VERISILICON_DC8200
	tristate "DRM Support for VeriSilicon DC8200"
	depends on DRM
	select DRM_KMS_HELPER
	select DRM_GEM_DMA_HELPER
	select DMA_CMA if HAVE_DMA_CONTIGUOUS
	select CMA if HAVE_DMA_CONTIGUOUS
	help
	  Say Y or M here if you want to enable support for the VeriSilicon
	  DC8200 display controller, which is found on SoCs such as the
	  StarFive JH7110 and T-HEAD TH1520.

config DRM_INNO_STARFIVE_HDMI
	bool "Innosilicon HDMI Transmitter support for StarFive JH7110"
	depends on DRM_VERISILICON_DC8200
	select DRM_INNO_HDMI
	select DRM_BRIDGE_CONNECTOR
	help
	  Say Y here to build the driver for the Innosilicon HDMI bridge
	  transmitter as found on the StarFive JH7110 SoC. This driver
	  acts as a glue layer between the main DC8200 display controller
	  and the generic Innosilicon HDMI bridge driver.
```
